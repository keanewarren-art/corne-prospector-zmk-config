## boards/shields/corne_prospector_dongle/Kconfig.shield
```kconfig
# No whitespace after the comma or in the keyboard name!
config SHIELD_CORNE_PROSPECTOR_DONGLE
    def_bool $(shields_list_contains,corne_prospector_dongle)
```

## config/west.yml
```yaml
manifest:
  remotes:
    - name: zmkfirmware
      url-base: https://github.com/zmkfirmware
    # - name: carrefinho
    #   url-base: https://github.com/carrefinho
    - name: not-in-stock
      url-base: https://github.com/not-in-stock
  projects:
    - name: zmk
      remote: zmkfirmware
      revision: main
      import: app/west.yml
    - name: prospector-zmk-module
      # remote: carrefinho
      # revision: feat/new-status-screens
      remote: not-in-stock
      revision: add-display-sleep
  self:
    path: config
```
